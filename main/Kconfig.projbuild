## main/Kconfig.projbuild
```kconfig
menu "IINE L1241 gamepad demo"
config IINE_PEER_NAME
    string "Additional device name to include in the gamepad list"
    default "Xbox Wireless Controller"
    help
        L1241 tested path: hold Pairing + A for 3 seconds, then select IINE GAMEPAD.
        An advertised name does not prove BLE HID compatibility.
        Controller/Gamepad/IINE names and advertised HID services are included too.
        Connections are selected with the badge buttons, never automatically.
config IINE_PEER_ADDRESS
    string "Optional BLE address filter AA:BB:CC:DD:EE:FF"
    default ""
    help
        Use the address printed by this demo, not a cached phone address.
        BLE private addresses may change. Leave empty to select on the LCD.
config IINE_LOG_RAW
    bool "Print changed raw HID input reports"
    default y
endmenu
```

## sdkconfig.defaults
```kconfig
CONFIG_IDF_TARGET="esp32c3"
CONFIG_ESPTOOLPY_FLASHMODE_DIO=y
CONFIG_ESPTOOLPY_FLASHFREQ_80M=y
CONFIG_ESPTOOLPY_FLASHSIZE_8MB=y
CONFIG_ESPTOOLPY_HEADER_FLASHSIZE_UPDATE=y
CONFIG_PARTITION_TABLE_CUSTOM=y
CONFIG_PARTITION_TABLE_CUSTOM_FILENAME="partitions.csv"
CONFIG_ESP_CONSOLE_USB_SERIAL_JTAG=y
CONFIG_ESP_CONSOLE_SECONDARY_NONE=y
CONFIG_FREERTOS_HZ=1000
CONFIG_BT_ENABLED=y
CONFIG_BT_NIMBLE_ENABLED=y
CONFIG_BT_NIMBLE_ROLE_CENTRAL=y
CONFIG_BT_NIMBLE_ROLE_OBSERVER=y
# IDF requires the peripheral role to compile the local GAP/GATT services.
# This demo never advertises or accepts inbound connections.
CONFIG_BT_NIMBLE_ROLE_PERIPHERAL=y
CONFIG_BT_NIMBLE_ROLE_BROADCASTER=n
CONFIG_BT_NIMBLE_GATT_CLIENT=y
CONFIG_BT_NIMBLE_GATT_SERVER=y
CONFIG_BT_NIMBLE_MAX_CONNECTIONS=1
CONFIG_BT_NIMBLE_MAX_BONDS=2
CONFIG_BT_NIMBLE_MAX_CCCDS=16
CONFIG_BT_NIMBLE_NVS_PERSIST=y
CONFIG_BT_NIMBLE_SM_LEGACY=y
CONFIG_BT_NIMBLE_SM_SC=y
CONFIG_BT_NIMBLE_ATT_PREFERRED_MTU=256
CONFIG_BT_NIMBLE_HOST_TASK_STACK_SIZE=6144
CONFIG_BT_CTRL_BLE_MAX_ACT=2
CONFIG_COMPILER_OPTIMIZATION_SIZE=y
```
